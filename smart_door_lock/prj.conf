## CMakeLists.txt
```
cmake_minimum_required(VERSION 3.20)

set(BOARD nrf52840dk_nrf52840)

find_package(Zephyr REQUIRED HINTS $ENV{ZEPHYR_BASE})

project(smart_door_lock)

target_sources(app PRIVATE src/main.c)

zephyr_library_include_directories(
  src/board src/custom_bluetooth src/file_system src/littlefs_file_system
  src/nfc src/nvs_file_system)

add_subdirectory(src/board)
add_subdirectory(src/custom_bluetooth)
add_subdirectory(src/file_system)
add_subdirectory(src/littlefs_file_system)
add_subdirectory(src/nfc)
add_subdirectory(src/nvs_file_system)
```

## prj.conf
```kconfig
CONFIG_PRINTK=y

CONFIG_NFC_T4T_NRFXLIB=y
CONFIG_NFC_NDEF_URI_MSG=y
CONFIG_NFC_NDEF=y
CONFIG_NFC_NDEF_MSG=y
CONFIG_NFC_NDEF_RECORD=y
CONFIG_NFC_NDEF_URI_REC=y

CONFIG_DK_LIBRARY=y

CONFIG_NET_BUF=y
CONFIG_ZCBOR=y
CONFIG_CRC=y
CONFIG_MCUMGR=y
CONFIG_STREAM_FLASH=y
CONFIG_FLASH_MAP=y

CONFIG_MAIN_STACK_SIZE=4096
CONFIG_SYSTEM_WORKQUEUE_STACK_SIZE=2304

CONFIG_BOOTLOADER_MCUBOOT=y

CONFIG_FLASH=y
CONFIG_IMG_MANAGER=y
CONFIG_MCUMGR_GRP_IMG=y
CONFIG_MCUMGR_GRP_OS=y

CONFIG_BT_HCI=y 
CONFIG_BT=y
CONFIG_BT_PERIPHERAL=y

CONFIG_DISK_ACCESS=y
CONFIG_DISK_DRIVERS=y
CONFIG_DISK_DRIVER_SDMMC=y
CONFIG_NVS=y
CONFIG_FILE_SYSTEM=y
CONFIG_FILE_SYSTEM_LITTLEFS=y
CONFIG_FS_LITTLEFS_BLK_DEV=y

CONFIG_BT_L2CAP_TX_MTU=498
CONFIG_BT_BUF_ACL_RX_SIZE=502
CONFIG_BT_BUF_ACL_TX_SIZE=502
CONFIG_BT_CTLR_DATA_LENGTH_MAX=251
CONFIG_MCUMGR_TRANSPORT_BT=y
CONFIG_MCUMGR_TRANSPORT_BT_AUTHEN=n
CONFIG_MCUMGR_TRANSPORT_BT_CONN_PARAM_CONTROL=y
CONFIG_BASE64=y
CONFIG_SHELL=y
CONFIG_SHELL_BACKEND_SERIAL=y
CONFIG_MCUMGR_TRANSPORT_SHELL=y
CONFIG_MCUMGR_TRANSPORT_BT_REASSEMBLY=y
CONFIG_MCUMGR_TRANSPORT_NETBUF_SIZE=2475
CONFIG_MCUMGR_GRP_OS_MCUMGR_PARAMS=y
CONFIG_MCUMGR_TRANSPORT_WORKQUEUE_STACK_SIZE=4608
CONFIG_MCUMGR_GRP_ZBASIC=y
CONFIG_MCUMGR_GRP_ZBASIC_STORAGE_ERASE=y
CONFIG_BT_CTLR_LE_PING=n
CONFIG_CLOCK_CONTROL_NRF_SHELL=n
CONFIG_DEVICE_SHELL=n
CONFIG_DEVMEM_SHELL=n
CONFIG_FLASH_SHELL=n

CONFIG_SETTINGS_FILE=y
CONFIG_SETTINGS=y
CONFIG_SETTINGS_FILE_PATH="/lfs/test"
```

## src/main.c
```c
#include <board.h>
#include <file_system.h>
#include <nfc.h>
#include <zephyr/kernel.h>
#include <zephyr/stats/stats.h>
#include <zephyr/sys/printk.h>
#include <zephyr/sys/reboot.h>
#include <zephyr/usb/usb_device.h>

#include "file_system.h"

/**
 * @brief The main function of the application.
 *
 * This is the entry point of the application. It initializes the system, sets up
 * various components, and enters the main application loop.
 *
 * @return An integer status code, typically 0 to indicate successful execution.
 */
int main(void)
{
    printk("Starting Nordic NFC Writable NDEF Message example\n");

    int err;

    err = file_system_init();

    if (err != 0)
    {
        printk("Cannot initialize file system!\n");
        printk("Restarting the board!\n");
        sys_reboot(SYS_REBOOT_COLD);
    }

    if (board_init() < 0)
    {
        printk("Cannot initialize board!\n");
        printk("Restarting the board!\n");
        sys_reboot(SYS_REBOOT_COLD);
    }

    if (nfc_t4t_init() < 0)
    {
        printk("Cannot initialize NFC t4t!\n");
        printk("Restarting the board!\n");
        sys_reboot(SYS_REBOOT_COLD);
    }

    while (1)
    {
        k_sleep(K_MSEC(5000));
        printk("While loop :)\n");
    }
    return 0;
}
```
